## tests/bluetooth/controller/ctrl_api/testcase.yaml
```yaml
common:
    tags: test_framework bluetooth bt_api bt_ull_llcp
tests:
  bluetooth.controller.ctrl_api.test:
     type: unit
     extra_args: CONFIG_ZTEST_NEW_API=y
```

## tests/bluetooth/controller/ctrl_chmu/testcase.yaml
```yaml
common:
    tags: test_framework bluetooth bt_chmu bt_ull_llcp
tests:
  bluetooth.controller.ctrl_chmu.test:
     type: unit
     extra_args: CONFIG_ZTEST_NEW_API=y
```

## tests/bluetooth/controller/ctrl_collision/testcase.yaml
```yaml
common:
    tags: test_framework bluetooth bt_collision bt_ull_llcp
tests:
  bluetooth.controller.ctrl_collision.test:
     type: unit
     extra_args: CONFIG_ZTEST_NEW_API=y
```

## tests/bluetooth/controller/ctrl_encrypt/testcase.yaml
```yaml
common:
    tags: test_framework bluetooth encrypt ull_llcp
tests:
  bluetooth.controller.ctrl_encrypt.test:
     type: unit
     extra_args: CONFIG_BT_CTLR_PHY=y CONFIG_BT_CTLR_PHY_CODED=y CONFIG_BT_CTLR_PHY_2M=y CONFIG_BT_CTLR_DATA_LENGTH_MAX=251
```

## tests/bluetooth/controller/ctrl_feature_exchange/testcase.yaml
```yaml
common:
    tags: test_framework bluetooth bt_feature_exchange bt_ull_llcp
tests:
  bluetooth.controller.ctrl_feature_exchange.test:
     type: unit
     extra_args: CONFIG_ZTEST_NEW_API=y
```

## tests/bluetooth/controller/ctrl_hci/testcase.yaml
```yaml
common:
    tags: test_framework bluetooth bt_ctrl_hci bt_ull_llcp
tests:
  bluetooth.controller.ctrl_hci.test:
     type: unit
     extra_args: CONFIG_ZTEST_NEW_API=y
```
